## sensores/SENSORES_ESP_IDF/main/Kconfig.projbuild
```kconfig
menu "Configurações Específicas"
    config WIFI_SSID
        string "WiFi SSID"
        default "ssid"
        help
            SSID da rede wifi que deseja conectar
    
    config WIFI_PASS
        string "WiFi pass"
        default "pass"
        help
            Senha da rede wifi

endmenu
```
